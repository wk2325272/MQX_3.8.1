%- Settings generated by Component Wizard
%;**%>12 Component name %>60: %get(DeviceName,Text)
%;**%>12 Settings %>60: %get(_SettingsGrp,Text)
%;**%>14 RTOS adaptor %>60: %get(RTOSAdaptorGrp,Text)
%;**%>16 Memory allocation %>60: %get(MemoryAllocationGroup,Text)
%;**%>18 User function for memory allocation %>60: %get(hasUserMallocFun,Text)
%if %get(hasUserMallocFun, Bool) = 'yes'
%;**%>20 User memory allocation function name %>60: %get(userMallocFunName,Text)
%else %- hasUserMallocFun
%endif %- hasUserMallocFun
%;**%>18 User function for memory deallocation %>60: %get(hasUserDeallocFun,Text)
%if %get(hasUserDeallocFun, Bool) = 'yes'
%;**%>20 User function name %>60: %get(userDeallocFunName,Text)
%else %- hasUserDeallocFun
%endif %- hasUserDeallocFun
%;**%>16 Critical section %>60: %get(Symbol,Text)
%;**%>18 User function for entering critical section %>60: %get(hasUserEnterCriticalFun,Text)
%if %get(hasUserEnterCriticalFun, Bool) = 'yes'
%;**%>20 User function name %>60: %get(userEnterCriticalFunName,Text)
%else %- hasUserEnterCriticalFun
%endif %- hasUserEnterCriticalFun
%;**%>18 User function for exiting critical section %>60: %get(hasUserExitCriticalFun,Text)
%if %get(hasUserExitCriticalFun, Bool) = 'yes'
%;**%>20 User function name %>60: %get(userExitCriticalFunName,Text)
%else %- hasUserExitCriticalFun
%endif %- hasUserExitCriticalFun
